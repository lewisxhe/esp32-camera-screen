## main/Kconfig.projbuild
```kconfig
menu "TTGO Configuration"

config ESP_WIFI_SSID
    string "WiFi SSID"
    default ""
    help
	SSID (network name) for the example to connect to.

config ESP_WIFI_PASSWORD
    string "WiFi Password"
    default ""
    help
	WiFi password (WPA or WPA2) for the example to use.

config MAX_STA_CONN
    int "Maximal STA connections"
    default 1
    help
	Max number of the STA connects to AP.

config SERVER_IP
    string "IP address of server"
    default "192.168.4.1"


choice GUI_LIB_SELECT
    prompt "GUI Library Select"
    default LVGL_GUI_ENABLE
    
    config LVGL_GUI_ENABLE
        bool "LittlevGL GUI Enable"

    config SELECT_NONE
        bool "Select None"

endchoice

    menu "LVGL settings"
        depends on LVGL_GUI_ENABLE

        config LVGL_USE_CUSTOM_DRIVER
            bool "Use Custom Driver Defined By Users"
            default n
            help 
                Select to use your own LCD driver. Instead, the driver in lvgl will be used.
                Sometimes the driver need to be modified or re-written, users can choose this option and 
                define their own driver in an independent component. 

        config LVGL_CUSTOM_DRIVER_COMPONENT_NAME
            string "LittlevGL Custom Driver Component Name"
            depends on LVGL_USE_CUSTOM_DRIVER
            default "lvgl_custom_driver"
            help
                Sometimes the driver need to be modified or re-written, users can choose this option and 
                define their own driver in an independent component. 
                Set this path to the cumtom board driver under project path, 
                default path is $(PROJECT_PATH)/lvgl_custom_driver

        config LVGL_CUSTOM_DRIVER_KEEP_OPTIONS
            bool "LittlevGL Custom Driver Keep The Same Options"
            depends on LVGL_USE_CUSTOM_DRIVER
            default y
            help
                Sometimes the driver need to be modified or re-written, users can choose this option and 
                define their own driver in an independent component. 
                Select this to enable the same options as the default driver
            
        config LVGL_USE_CONFIGURED_OPTIONS
            bool
            default y if !LVGL_USE_CUSTOM_DRIVER
            default y if LVGL_CUSTOM_DRIVER_KEEP_OPTIONS
            default n

                                    
        config LVGL_DRIVER_TOUCH_SCREEN_ENABLE
            bool "LittlevGL Touch Screen Enable"
            default n
            help 
                "Select to enable LittlevGL touch screen"

        config LVGL_DRIVER_TOGGLE_ENABLE
            bool "LittlevGL Toggle Input Device Enable"
            default n
            help
                "Select to enable LittlevGL Toggle input device"

        choice LVGL_DRIVER_MODE
            prompt "Display Driver Mode"
            default LVGL_LCD_DRIVER_FRAMEBUFFER_MODE

            config LVGL_LCD_DRIVER_FRAMEBUFFER_MODE
                bool "Select LittlevGL Driver Buffered Mode"
            config LVGL_LCD_DRIVER_API_MODE
                bool "Select LittlevGL Driver Unbuffered Mode" 

        endchoice
                                
        config LVGL_DRIVER_AUTO_FLUSH_INTERVAL
            #depends on LVGL_LCD_DRIVER_FRAMEBUFFER_MODE
            int "LittlevGL Driver Auto Flush Interval(ms)"
            range 0 500
            default 50
            help 
                "Select to set the minimum screen flush interval for framebuffer mode"
                                
        config LVGL_DRIVER_DOUBLE_BUFFER_ENABLE
            depends on LVGL_LCD_DRIVER_FRAMEBUFFER_MODE
            bool "LittlevGL Driver Double Buffer Enable"
            default y
            help 
                "Enable Double Buffer For LittlevGL"

        choice LVGL_DISP_ROTATE
            prompt "Choose Screen Rotate"
            default LVGL_DISP_ROTATE_90

            config LVGL_DISP_ROTATE_0
                bool "GDISP_ROTATE_0"

            config LVGL_DISP_ROTATE_90
                bool "GDISP_ROTATE_90"

            config LVGL_DISP_ROTATE_180
                bool "GDISP_ROTATE_180"

            config LVGL_DISP_ROTATE_270
                bool "GDISP_ROTATE_270"
                
        endchoice

        menu "Config Driver"
            depends on LVGL_USE_CONFIGURED_OPTIONS

            choice LVGL_DRIVER_TOGGLE
                prompt "Choose Toggle Input Driver"
                depends on LVGL_DRIVER_TOGGLE_ENABLE

                config LVGL_DRIVER_TOGGLE_BUTTON
                    bool "BUTTON"

                config LVGL_DRIVER_TOGGLE_TOUCHPAD
                    bool "TOUCHPAD"

            endchoice

            menu "Button Toggle Input Device Configuration"
                depends on LVGL_DRIVER_TOGGLE_BUTTON

                config LVGL_TOGGLE_BUTTON_GPIO1
                    int "LittlevGL Toggle Button Num 1's GPIO"
                    range 0 39
                    default 4
                config LVGL_TOGGLE_BUTTON_GPIO2
                    int "LittlevGL Toggle Button Num 2's GPIO"
                    range 0 39
                    default 15

            endmenu

            menu "TouchPad Toggle Input Device Configuration"
                depends on LVGL_DRIVER_TOGGLE_TOUCHPAD

                config LVGL_TOGGLE_TOUCHPAD_NUM1
                    int "LittlevGL Toggle TouchPad Num 1"
                    range 0 10
                    default 3
                config LVGL_TOGGLE_TOUCHPAD_NUM2
                    int "LittlevGL Toggle TouchPad Num 2"
                    range 0 10
                    default 9

            endmenu
                
            choice LVGL_DRIVER_TOUCH_SCREEN
                prompt "Choose Touch Screen Driver"
                depends on LVGL_DRIVER_TOUCH_SCREEN_ENABLE
                
                config LVGL_DRIVER_TOUCH_XPT2046
                    bool "XPT2046"

                config LVGL_DRIVER_TOUCH_FT5X06
                    bool "FT5X06"
                
            endchoice
        
            menu "XPT2046 Touch Screen Pin Configuration"
                depends on LVGL_DRIVER_TOUCH_XPT2046

                config LVGL_TOUCH_CS_GPIO
                    int "LittlevGL Touch CS GPIO"
                    range 0 39
                    default 32
                config LVGL_TOUCH_IRQ_GPIO
                    int "LittlevGL Touch IRQ GPIO"
                    range 0 39
                    default 33

            endmenu
        
            menu "FT5X06 Touch Screen Pin Configuration"
                depends on LVGL_DRIVER_TOUCH_FT5X06

                config LVGL_TOUCH_IIC_NUM
                    int "LittlevGL Touch IIC Num"
                    range 0 1
                    default 0
                config LVGL_TOUCH_SCL_GPIO
                    int "LittlevGL Touch SCL GPIO"
                    range 0 39
                    default 3
                config LVGL_TOUCH_SDA_GPIO
                    int "LittlevGL Touch SDA GPIO"
                    range 0 39
                    default 1

            endmenu
            
            choice LVGL_DRIVER_SCREEN
                depends on LVGL_USE_CONFIGURED_OPTIONS
                prompt "Choose Screen Driver"
                default LVGL_DRIVER_ST7789
                help
                    CHOOSE SCREEN DRIVER.
                

                config LVGL_DRIVER_ST7789
                    bool "ST7789"
                #config LVGL_DRIVER_EPAPER
                #    bool "EPAPER"

            endchoice

            menu "ST7789 Screen Pin Configuration"
                depends on LVGL_DRIVER_ST7789

                choice LVGL_LCD_SPI_SELECT
                    prompt "Select SPI Port"
                    default LVGL_LCD_HSPI
                
                    config LVGL_LCD_HSPI
                        bool "Select HSPI"

                    config LVGL_LCD_VSPI
                        bool "Select VSPI"

                endchoice
                config LVGL_LCD_SPI_NUM
                    int
                    default 1 if  LVGL_LCD_HSPI
                    default 2 if  LVGL_LCD_VSPI
                config LVGL_LCD_SPI_CLOCK
                    int "LittlevGL LCD SPI Clock"
                    range 0 40000000
                    default 20000000

                config LVGL_LCD_MISO_GPIO
                    int "LittlevGL LCD MISO GPIO"
                    range 0 39
                    default 22
                config LVGL_LCD_MOSI_GPIO
                    int "LittlevGL LCD MOSI GPIO"
                    range 0 39
                    default 19
                config LVGL_LCD_CLK_GPIO
                    int "LittlevGL LCD CLK GPIO"
                    range 0 39
                    default 21
                config LVGL_LCD_CS_GPIO
                    int "LittlevGL LCD CS GPIO"
                    range 0 39
                    default 12
                config LVGL_LCD_DC_GPIO
                    int "LittlevGL LCD DC GPIO"
                    range 0 39
                    default 15
                config LVGL_LCD_RESET_GPIO
                    int "LittlevGL LCD RESET GPIO"
                    range -1 39
                    default -1
                config LVGL_LCD_BL_GPIO
                    int "LittlevGL LCD BL GPIO"
                    range 0 39
                    default 2

            endmenu


            config ST7789_LVGL_DRIVER_SCREEN_WIDTH
                depends on LVGL_DRIVER_ST7789
                int "LittlevGL Screen Width (pixels)"
                range 0 5000
                default 240
                help
                    "LittlevGL Screen Width (pixels)"

            config ST7789_LVGL_DRIVER_SCREEN_HEIGHT
                depends on LVGL_DRIVER_ST7789
                int "LittlevGL Screen Height (pixels)"
                range 0 5000
                default 240
                help
                    "LittlevGL Screen Height (pixels)"
                    
                    
            config LVGL_DRIVER_SCREEN_WIDTH
                int
                default ST7789_LVGL_DRIVER_SCREEN_WIDTH  if  LVGL_DRIVER_ST7789
                    
            config LVGL_DRIVER_SCREEN_HEIGHT
                int
                default ST7789_LVGL_DRIVER_SCREEN_HEIGHT  if  LVGL_DRIVER_ST7789

        endmenu

    endmenu

endmenu
```
